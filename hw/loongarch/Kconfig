## hw/loongarch/Kconfig
```kconfig
config LOONGSON3_LS7A
    bool
    imply VGA_PCI
    imply VIRTIO_VGA
    imply PCI_DEVICES
    select ISA_BUS
    select SERIAL
    select SERIAL_ISA
    select VIRTIO_PCI
    select PCI_EXPRESS_7A
    select LOONGARCH_IPI
    select LOONGARCH_PCH_PIC
    select LOONGARCH_PCH_MSI
    select LOONGARCH_EXTIOI
    select LS7A_RTC
    select FW_CFG_LOONGARCH
    select SMBIOS
    select ACPI_LOONGARCH
    select ACPI_PCI

config FW_CFG_LOONGARCH
    bool
```
